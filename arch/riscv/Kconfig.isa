## arch/riscv/Kconfig.isa
```kconfig
# Copyright (c) 2022 Carlo Caione <ccaione@baylibre.com>
# SPDX-License-Identifier: Apache-2.0

config RISCV_ISA_RV32I
	bool
	help
	  RV32I Base Integer Instruction Set - 32bit

config RISCV_ISA_RV64I
	bool
	default y if 64BIT
	help
	  RV64I Base Integer Instruction Set - 64bit
	  
config RISCV_ISA_EXT_M
	bool
	help
	  (M) - Standard Extension for Integer Multiplication and Division

	  Standard integer multiplication and division instruction extension,
	  which is named "M" and contains instructions that multiply or divide
	  values held in two integer registers.

config RISCV_ISA_EXT_F
	bool
	help
	  (F) - Standard Extension for Single-Precision Floating-Point

	  Standard instruction-set extension for single-precision
	  floating-point, which is named "F" and adds single-precision
	  floating-point computational instructions compliant with the IEEE
	  754-2008 arithmetic standard.


config RISCV_ISA_EXT_G
	bool
	select RISCV_ISA_RV64I
	select RISCV_ISA_EXT_M
	select RISCV_ISA_EXT_ZICSR
	select RISCV_ISA_EXT_ZIFENCEI
	help
	  (IMAFDZicsr_Zifencei) IMAFDZicsr_Zifencei extensions


config RISCV_ISA_EXT_ZICSR
	bool
	help
	  (Zicsr) - Standard Extension for Control and Status Register (CSR) Instructions

	  The "Zicsr" extension introduces support for the full set of CSR
	  instructions that operate on CSRs registers.

config RISCV_ISA_EXT_ZIFENCEI
	bool
	help
	  (Zifencei) - Standard Extension for Instruction-Fetch Fence

	  The "Zifencei" extension includes the FENCE.I instruction that
	  provides explicit synchronization between writes to instruction
	  memory and instruction fetches on the same hart.

config RISCV_ISA_EXT_ZBA
	bool
	help
	  (Zba) - Zba BitManip Extension

	  The Zba instructions can be used to accelerate the generation of
	  addresses that index into arrays of basic types (halfword, word,
	  doubleword) using both unsigned word-sized and XLEN-sized indices: a
	  shifted index is added to a base address.

config RISCV_ISA_EXT_ZBB
	bool
	help
	  (Zbb) - Zbb BitManip Extension (Basic bit-manipulation)

	  The Zbb instructions can be used for basic bit-manipulation (logical
	  with negate, count leading / trailing zero bits, count population,
	  etc...).

config RISCV_ISA_EXT_ZBC
	bool
	help
	  (Zbc) - Zbc BitManip Extension (Carry-less multiplication)

	  The Zbc instructions can be used for carry-less multiplication that
	  is the multiplication in the polynomial ring over GF(2).

config RISCV_ISA_EXT_ZBS
	bool
	help
	  (Zbs) - Zbs BitManip Extension (Single-bit instructions)

	  The Zbs instructions can be used for single-bit instructions that
	  provide a mechanism to set, clear, invert, or extract a single bit in
	  a register.
```

## boards/riscv/aws_fpga/Kconfig.board
```kconfig
# SPDX-License-Identifier: Apache-2.0

config BOARD_AWS_FPGA
	bool "AWS RISCV32 target"
	depends on SOC_RISCV_AWS
	select QEMU_TARGET
	select RISCV_ISA_EXT_G
```

## boards/riscv/aws_fpga/Kconfig.defconfig
```kconfig
# SPDX-License-Identifier: Apache-2.0

config BUILD_OUTPUT_HEX
	default y

config BOARD
	default "aws_fpga" if BOARD_AWS_FPGA
```

## boards/riscv/aws_fpga/aws_fpga_defconfig
```kconfig
# SPDX-License-Identifier: Apache-2.0

CONFIG_SOC_SERIES_RISCV_AWS=y
CONFIG_SOC_RISCV_AWS=y
CONFIG_BOARD_AWS_FPGA=y
CONFIG_UART_XLNX_UARTLITE=y
CONFIG_STACK_SENTINEL=n
CONFIG_QEMU_ICOUNT_SHIFT=0
CONFIG_XIP=n
CONFIG_RISCV_PMP=n
```

## soc/riscv/riscv-privilege/Kconfig
```kconfig
# Configuration options for riscv SOCs supporting the riscv privileged
# architecture specification

# Copyright (c) 2017 Jean-Paul Etienne <fractalclone@gmail.com>
# SPDX-License-Identifier: Apache-2.0

config SOC_FAMILY_RISCV_PRIVILEGE
	bool

config SOC_FAMILY
	string
	default "riscv-privilege"
	depends on SOC_FAMILY_RISCV_PRIVILEGE


source "soc/riscv/riscv-privilege/*/Kconfig.soc"
```

## soc/riscv/riscv-privilege/aws/Kconfig.soc
```kconfig
# Copyright (c) 2020 Cobham Gaisler AB
# SPDX-License-Identifier: Apache-2.0

choice
	prompt "QEMU RISC-V VirtIO Board"
	depends on SOC_SERIES_RISCV_AWS

config SOC_RISCV_AWS
	bool "QEMU RISC-V VirtIO Board"
	select INCLUDE_RESET_VECTOR
	select CONFIG_RISCV_ISA_EXT_M
	select CONFIG_64BIT

endchoice
```
